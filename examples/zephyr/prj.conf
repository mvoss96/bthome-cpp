## CMakeLists.txt
```
cmake_minimum_required(VERSION 3.20)
find_package(Zephyr REQUIRED HINTS $ENV{ZEPHYR_BASE})
project(bthome_zephyr_example)

target_sources(app PRIVATE src/main.cpp)
# Header-only: point at bthome-cpp/src.
target_include_directories(app PRIVATE ${CMAKE_CURRENT_SOURCE_DIR}/../../src)
```

## prj.conf
```kconfig
CONFIG_BT=y
CONFIG_BT_PERIPHERAL=y
CONFIG_BT_DEVICE_NAME="bthome"
CONFIG_CPP=y
CONFIG_STD_CPP17=y
```

## src/main.cpp
```c
// Zephyr example: advertise a BTHome v2 payload.
//
// serviceData() returns exactly what BT_DATA_SVC_DATA16 expects:
//   [UUID lo][UUID hi][device-info][measurements...]
#include "bthome.h"

#include <zephyr/bluetooth/bluetooth.h>
#include <zephyr/kernel.h>

// Built once at startup; the bytes stay valid because `packet` is static.
static BTHome::Packet<31> packet;

int main(void) {
    packet.add(BTHome::temperature(22.4f));
    packet.add(BTHome::humidity(54.3f));
    packet.add(BTHome::battery(92));

    if (bt_enable(nullptr)) {
        return -1;
    }

    const struct bt_data ad[] = {
        BT_DATA_BYTES(BT_DATA_FLAGS, BT_LE_AD_NO_BREDR),
        BT_DATA(BT_DATA_SVC_DATA16, packet.serviceData(),
                packet.serviceDataSize()),
    };

    // Advertise from the identity address. Plain BT_LE_ADV_NCONN uses a new
    // random address on every start, and receivers identify BTHome devices by it.
    bt_le_adv_start(BT_LE_ADV_NCONN_IDENTITY, ad, ARRAY_SIZE(ad), nullptr, 0);
    return 0;
}
```
